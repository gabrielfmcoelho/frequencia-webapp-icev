//ESP32----------------------------
#include <WiFi.h>
#include <HTTPClient.h>
#include <time.h>
#include <stdlib.h>
#include <ArduinoJson.h>

//RFID-----------------------------
#include <SPI.h>
#include <MFRC522.h>
//OLED-----------------------------
#include <Wire.h>
#include <Adafruit_GFX.h>      //https://github.com/adafruit/Adafruit-GFX-Library
#include <Adafruit_SSD1306.h>  //https://github.com/adafruit/Adafruit_SSD1306

//Pinos I2C para Display ----------
#define SCREEN_WIDTH 128  // OLED display largura, em pixels
#define SCREEN_HEIGHT 64  // OLED display altura, em pixels
#define OLED_RESET 0

#define RST_PIN 2
#define SS_PIN 5

//Led RGB 1------------------------
#define LED1_R 27
#define LED1_G 26
#define LED1_B 25

//Led RGB 2------------------------
#define LED2_R 33
#define LED2_G 32
#define LED2_B 14

#define BUZZ_PIN 13

int freq = 2000;
int channel = 0;
int resolution = 8;

//**********API TEMPO & API RFID**************
int timezone = -3 * 3600;  // Fuso horario -3
int time_dst = 0;
String getData, Link;
String OldCardID = "";
unsigned long previousMillis1 = 0;
unsigned long previousMillis2 = 0;
String URL = "https://respt-api-rfid.onrender.com/frequencia";
unsigned long previousMillis = 0;
const unsigned long interval = 60000;  // Intervalo de 60 segundos

//********ICONES DO DISPLAY************
#define Wifi_start_width 54
#define Wifi_start_height 49
const uint8_t PROGMEM Wifi_start_bits[] = {
  0x00, 0x00, 0x00, 0x00, 0x00, 0x00, 0x00, 0x00, 0x00, 0x00, 0x00, 0x00,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 0x00
};
#define Wifi_connected_width 63
#define Wifi_connected_height 49
const uint8_t PROGMEM Wifi_connected_bits[] = {
  0x00, 0x00, 0x00, 0x00, 0x00, 0x00, 0x00, 0x00, 0x00, 0x00, 0x00, 0x00,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 0x00
};
// 'logo1', 64x32px
#define logo1_width 95
#define logo1_height 64
const unsigned char logo1 [] PROGMEM = {
	0x00, 0x00, 0x00, 0x00, 0x00, 0x00, 0x00, 0x00, 0x00, 0x00, 0x00, 0x00, 0x00, 0x00, 0x00, 0x00, 
	0x00, 0x00, 0x00, 0x00, 0x00, 0x00, 0x00, 0x00, 0x00, 0x00, 0x00, 0x00, 0x00, 0x00, 0x00, 0x00, 
	0x00, 0x00, 0x00, 0x00, 0x00, 0x00, 0x00, 0x00, 0x00, 0x00, 0x00, 0x00, 0x00, 0x00, 0x00, 0x00, 
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	0x00, 0x00, 0x00, 0x00, 0x00, 0x00, 0x00, 0x00, 0x00, 0x00, 0x00, 0x00, 0x00, 0x00, 0x00, 0x00
};

#define logo2_width 128
#define logo2_height 26
const unsigned char logo2 [] PROGMEM = {
0x00, 0x00, 0x00, 0x00, 0x00, 0x00, 0x00, 0x00, 0x00, 0x00, 0x00, 0x00, 0x00, 0x00, 0x00, 0x00, 
	0x18, 0x00, 0x00, 0x00, 0x00, 0x00, 0x00, 0x00, 0x00, 0x00, 0x00, 0x00, 0x00, 0x00, 0x00, 0x00, 
	0x3c, 0x00, 0x00, 0x00, 0x00, 0x00, 0x00, 0x00, 0x00, 0x00, 0x00, 0x00, 0x00, 0x00, 0x00, 0x00, 
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	0x00, 0x00, 0x00, 0x00, 0x00, 0x00, 0x00, 0x00, 0x00, 0x00, 0x00, 0x01, 0x00, 0x00, 0x00, 0x00
};

Adafruit_SSD1306 display(SCREEN_WIDTH, SCREEN_HEIGHT, &Wire, OLED_RESET);  // cria instancia display
MFRC522 mfrc522(SS_PIN, RST_PIN);
String lastCardID = "";

const char *ssid = "coelho";
const char *password = "123456789";
const char *device_token = "Modulo de teste";

void splashScreen(){
  display.drawBitmap(0, 20, logo2, logo2_width, logo2_height, WHITE);
  display.display();
  delay(5000);
  display.clearDisplay();
  display.drawBitmap(10, 0, logo1, logo1_width, logo1_height, WHITE);
  display.display();
  delay(5000);
}

const char* wl_status_to_string(wl_status_t status) {
  switch (status) {
    case WL_NO_SHIELD: return "WL_NO_SHIELD";
    case WL_IDLE_STATUS: return "WL_IDLE_STATUS";
    case WL_NO_SSID_AVAIL: return "WL_NO_SSID_AVAIL";
    case WL_SCAN_COMPLETED: return "WL_SCAN_COMPLETED";
    case WL_CONNECTED: return "WL_CONNECTED";
    case WL_CONNECT_FAILED: return "WL_CONNECT_FAILED";
    case WL_CONNECTION_LOST: return "WL_CONNECTION_LOST";
    case WL_DISCONNECTED: return "WL_DISCONNECTED";
  }
}

void emitBeep(String tipo) {
  if (tipo == "ok") {  //Ok
    ledcWriteTone(0, 1000);
    delay(200);
    ledcWriteTone(0, 1500);
    delay(200);
    ledcWriteTone(0, 2000);
    delay(500);
    ledcWriteTone(0, 0);
  } else {
    if (tipo == "erro") {
      ledcWriteTone(0, 3000);
      delay(200);
      ledcWriteTone(0, 0);
      delay(200);
      ledcWriteTone(0, 3000);
      delay(500);
      ledcWriteTone(0, 0);
    }
  }
}

void LED(String cor) {
  if (cor == "BRANCO") {
    // Led 1
    digitalWrite(LED1_R, LOW);
    digitalWrite(LED1_G, LOW);
    digitalWrite(LED1_B, LOW);
    // Led 2
    digitalWrite(LED2_R, LOW);
    digitalWrite(LED2_G, LOW);
    digitalWrite(LED2_B, LOW);
  } else if (cor == "AMARELO") {
    // Led 1
    digitalWrite(LED1_R, LOW);
    digitalWrite(LED1_G, LOW);
    digitalWrite(LED1_B, HIGH);
    // Led 2
    digitalWrite(LED2_R, LOW);
    digitalWrite(LED2_G, LOW);
    digitalWrite(LED2_B, HIGH);
  } else if (cor == "VERMELHO") {
    // Led 1
    digitalWrite(LED1_R, LOW);
    digitalWrite(LED1_G, HIGH);
    digitalWrite(LED1_B, HIGH);
    // Led 2
    digitalWrite(LED2_R, LOW);
    digitalWrite(LED2_G, HIGH);
    digitalWrite(LED2_B, HIGH);
  } else if (cor == "VERDE") {
    // Led 1
    digitalWrite(LED1_R, HIGH);
    digitalWrite(LED1_G, LOW);
    digitalWrite(LED1_B, HIGH);
    // Led 2
    digitalWrite(LED2_R, HIGH);
    digitalWrite(LED2_G, LOW);
    digitalWrite(LED2_B, HIGH);
  } else if (cor == "AZUL") {
    // Led 1
    digitalWrite(LED1_R, HIGH);
    digitalWrite(LED1_G, HIGH);
    digitalWrite(LED1_B, LOW);
    // Led 2
    digitalWrite(LED2_R, HIGH);
    digitalWrite(LED2_G, HIGH);
    digitalWrite(LED2_B, LOW);
  } else if (cor == "ROXO") {
    // Led 1
    digitalWrite(LED1_R, LOW);
    digitalWrite(LED1_G, HIGH);
    digitalWrite(LED1_B, LOW);
    // Led 2
    digitalWrite(LED2_R, LOW);
    digitalWrite(LED2_G, HIGH);
    digitalWrite(LED2_B, LOW);
  } else if (cor == "PRETO") {
    // Led 1
    digitalWrite(LED1_R, HIGH);
    digitalWrite(LED1_G, HIGH);
    digitalWrite(LED1_B, HIGH);
    // Led 2
    digitalWrite(LED2_R, HIGH);
    digitalWrite(LED2_G, HIGH);
    digitalWrite(LED2_B, HIGH);
  }
}

void iniciarLeituraLED() {
  LED("BRANCO");
  delay(100);
  LED("PRETO");
  delay(100);
  LED("BRANCO");
  delay(100);
}

void LeituraLED() {
  LED("AMARELO");
  delay(100);
  LED("PRETO");
  delay(100);
  LED("AMARELO");
  delay(100);
}

void OkLED(){
  LED("VERDE");
  delay(500);
  LED("PRETO");
  delay(100);
  LED("VERDE");
}

void NotOkLED(){
  LED("VERMELHO");
  delay(500);
  LED("PRETO");
  delay(100);
  LED("VERMELHO");
}

void checkRFID(){
  while (!mfrc522.PCD_PerformSelfTest()) {
    Serial.println("Falha no autoteste do leitor RFID");
    display.clearDisplay();
    display.setTextSize(3);       // Normal 1:1 pixel scale
    display.setTextColor(WHITE);  // Draw white text
    display.setCursor(2, 20);    // Start at top-left corner
    display.print(F("RFID Falhou"));
    display.setCursor(0, 50);
    display.setTextSize(2);
    display.display();
    delay(1000);
  }
  Serial.println("Antena RFID Ok!");
  display.clearDisplay();
  display.setTextSize(3);       // Normal 1:1 pixel scale
  display.setTextColor(WHITE);  // Draw white text
  display.setCursor(2, 20);    // Start at top-left corner
  display.print(F("RFID OK"));
  display.setCursor(0, 50);
  display.setTextSize(2);
  display.display();
  delay(1000);
}

void timeAdjust(){
  display.clearDisplay();
  display.setTextSize(2);       // Normal 1:1 pixel scale
  display.setTextColor(WHITE);  // Draw white text
  display.setCursor(10, 15);    // Start at top-left corner
  display.print(F("Ajustando Horario..."));
  display.setCursor(0, 50);
  display.setTextSize(2);
  display.display();
  delay(1000);
  configTime(timezone, time_dst, "pool.ntp.org", "time.nist.gov");
  time_t now = time(nullptr); // Get current time
  if (now > 0) {
    display.clearDisplay();
    display.setTextSize(2);       // Normal 1:1 pixel scale
    display.setTextColor(WHITE);  // Draw white text
    display.setCursor(10, 15);    // Start at top-left corner
    display.print(F("Horario  Ajustado!"));
    display.setCursor(0, 50);
    display.setTextSize(2);
    display.display();
    delay(1000);
  } else {
    display.clearDisplay();
    display.setTextSize(2);       // Normal 1:1 pixel scale
    display.setTextColor(WHITE);  // Draw white text
    display.setCursor(10, 15);    // Start at top-left corner
    display.print(F("Horario Falhou!"));
    display.setCursor(0, 50);
    display.setTextSize(2);
    display.display();
    delay(1000);
  }
}

void EscreverDisplay(String code, String name, String subject) {
  display.clearDisplay();
  display.setTextSize(2);
  display.setTextColor(WHITE);
  display.setCursor(8, 20);
  if (code == "1") {
    display.print("Registrado");
  } else {
    display.print("Negado");
  }
  display.display();
  delay(2000);
  display.clearDisplay();
  if (code == "1" || code == "0"){
    display.setTextSize(2);       // Normal 2:2 pixel scale
    display.setTextColor(WHITE);  // Draw white text
    display.setCursor(8, 20);     // Start at top-left corner
    display.print(name);
    display.display();
    delay(2000);
    display.clearDisplay();
  }
  else {
    display.setTextSize(3);       // Normal 2:2 pixel scale
    display.setTextColor(WHITE);  // Draw white text
    display.setCursor(2, 20);     // Start at top-left corner
    display.print("AVISO");
    display.display();
    delay(2000);
    display.clearDisplay();
  }
  display.setTextSize(2); 
  display.setCursor(8, 20);
  display.print(subject);
  display.display();
  delay(2000);
  display.clearDisplay();
}

void writeTimeDisplay() {
  // previousMillis1 = millis();
  display.clearDisplay();

  time_t now = time(nullptr);
  struct tm *p_tm = localtime(&now);
  display.setTextSize(1);       // Normal 2:2 pixel scale
  display.setTextColor(WHITE);  // Draw white text
  display.setCursor(10, 0);
  // Serial.println(p_tm);

  display.setTextSize(4);       // Normal 2:2 pixel scale
  display.setTextColor(WHITE);  // Draw white text
  display.setCursor(5, 21);
  // Serial.println(p_tm->tm_hour);
  // Serial.println(p_tm->tm_min);
  if ((p_tm->tm_hour) < 10) {
    display.print("0");
    display.print(p_tm->tm_hour);
  } else display.print(p_tm->tm_hour);

  display.print(":");

  if ((p_tm->tm_min) < 10) {
    display.print("0");
    display.println(p_tm->tm_min);
  } else display.println(p_tm->tm_min);

  display.display();
}

bool checkWifiConnection(){
  return WiFi.isConnected();
}

void connectToWiFi() {
  WiFi.mode(WIFI_OFF);  //Prevents reconnection issue (taking too long to connect)
  delay(1000);
  WiFi.mode(WIFI_STA);
  Serial.print("Conectando a ");
  Serial.println(ssid);
  WiFi.begin(ssid, password);

  display.clearDisplay();
  display.setTextSize(1);       // Normal 1:1 pixel scale
  display.setTextColor(WHITE);  // Draw white text
  display.setCursor(0, 0);      // Start at top-left corner
  display.print(F("Conectando a \n"));
  display.setCursor(0, 50);
  display.setTextSize(2);
  display.print(ssid);
  display.drawBitmap(73, 10, Wifi_start_bits, Wifi_start_width, Wifi_start_height, WHITE);
  display.display();

  while (WiFi.status() != WL_CONNECTED) {
    delay(500);
    Serial.print(".");
  }
  Serial.println("");
  Serial.println("Conectado");
  LED("VERDE");
  display.clearDisplay();
  display.setTextSize(2);       // Normal 1:1 pixel scale
  display.setTextColor(WHITE);  // Draw white text
  display.setCursor(8, 0);      // Start at top-left corner
  display.print(F("Conectado \n"));
  display.drawBitmap(33, 15, Wifi_connected_bits, Wifi_connected_width, Wifi_connected_height, WHITE);
  display.display();

  Serial.print("IP address: ");
  Serial.println(WiFi.localIP());  //IP address assigned to your ESP

  delay(1000);
}

void lerCartao() {
  // mfrc522.PCD_Reset();
  if (mfrc522.PICC_IsNewCardPresent() && mfrc522.PICC_ReadCardSerial()) {
    String cardID = "";
    for (byte i = 0; i < mfrc522.uid.size; i++) {
      cardID += String(mfrc522.uid.uidByte[i], HEX);
    }
    LeituraLED();
    Serial.println(cardID);
    if (cardID == lastCardID) {
      // ledcWriteTone(channel, 3000);
      //readOkLED();
      //emitBeep("ok", 1000, 500);
      Serial.println("Leu");
      // EscreverDisplay("1", "Igual!", cardID);
      // LED("VERMELHO");
      // delay(100);
    } else {
      // ledcWriteTone(channel, 1000);
      // EscreverDisplay("1", "Diferente", cardID);
      lastCardID = cardID;
      Serial.println("Leu");
      comunicarfrequencia(cardID);
      // LED("AZUL");
      // delay(100);
    }
    // delay(1000);
    // ledcWriteTone(channel, 0);
    mfrc522.PICC_HaltA();
    mfrc522.PCD_StopCrypto1();
  } else {
    // EscreverDisplay("2", "Nao lido!", "000");
    Serial.println("Nao Leu");
    // emitBeep("erro", 1000, 500);
    // LED("VERDE");
  }
}

void comunicarfrequencia(String cardID) {
  Serial.println("Enviando cartão");

  // Cria uma instância do cliente HTTP
  HTTPClient http;
  
  // Monta a URL completa do servidor com os dados do cartão
  String url = URL + "?cardData=" + cardID;
  
  // Envia a requisição GET para o servidor
  http.begin(url);
  int httpCode = http.GET();
  // Verifica o código de resposta HTTP

  DynamicJsonDocument jsonBuffer(1024);

  if (httpCode == 200) {
    Serial.println("Recebendo payload");
    String payload = http.getString();  
    DeserializationError error = deserializeJson(jsonBuffer, payload);
    Serial.println(error.c_str());
    String code = jsonBuffer[0];
    String subject = jsonBuffer[1];
    String name = jsonBuffer[2];

    if (code == "1"){
      Serial.println("Aprovado");
      EscreverDisplay(code, name, subject);
      OkLED();
      emitBeep("ok");
    }

    else if (code == "0"){
      Serial.println("Negado");
      EscreverDisplay(code, name, subject);
      NotOkLED();
      emitBeep("erro");
    }

    else if (code == "2"){
      Serial.println("Não Reconhecido");
      EscreverDisplay(code, "", "TAG  Nao  Registrada");
      NotOkLED();
      emitBeep("erro");
    }

    else {
      NotOkLED();
      emitBeep("erro");
      Serial.println(code);
    }
  }
  else {
    NotOkLED();
    emitBeep("erro");
    Serial.println("http não ok");
    EscreverDisplay("3","S/ Resposta", "do Servidor");
  }
}

void setup() {
  //Led 1------------------
  pinMode(LED1_R, OUTPUT);
  pinMode(LED1_G, OUTPUT);
  pinMode(LED1_B, OUTPUT);

  //Led 2------------------
  pinMode(LED2_R, OUTPUT);
  pinMode(LED2_G, OUTPUT);
  pinMode(LED2_B, OUTPUT);

  //Buzz ------------------
  pinMode(BUZZ_PIN, OUTPUT);
  ledcSetup(channel, freq, resolution);
  ledcAttachPin(BUZZ_PIN, channel);

  SPI.begin();

  if (!display.begin(SSD1306_SWITCHCAPVCC, 0x3C)) {  // Endereço 0x3D para display 128x64
    Serial.println(F("Tela não inicializada!"));
    for (;;)
      ;  // Loop infinito enquanto não iniciar
  }
  Serial.begin(115200);
  display.clearDisplay();
  display.display();
  splashScreen();
  LED("BRANCO");
  delay(500);
  LED("ROXO");

  // Iniciando RFID
  mfrc522.PCD_Init();
  checkRFID();


  if (!WiFi.isConnected()) {
    connectToWiFi();  //re-testagem da conexão de wifi
  }

  timeAdjust();
}



void loop() {
  if (!checkWifiConnection()) {
      LED("VERMELHO");
      Serial.println("Conexão Wi-Fi perdida. Tentando reconectar...");
      display.clearDisplay();
      display.setTextSize(2);
      display.setTextColor(WHITE);
      display.setCursor(10, 10);
      display.print("Wifi perdida...");
      display.display();
      delay(500);
      connectToWiFi();  // Tenta reconectar à rede Wi-Fi
  }
  
  writeTimeDisplay();
  unsigned long currentMillis = millis();
  if (currentMillis - previousMillis >= interval) {
    checkRFID();
    display.clearDisplay();
    display.display();
    writeTimeDisplay();
    previousMillis = currentMillis;  // Atualiza o valor do último tempo de impressão
    
  }
  if (currentMillis - previousMillis2 >= 5000) {
    previousMillis2 = millis();
    lastCardID="";
  }
  
  // if (millis() - previousMillis1 >= 500) {
  //   // writeTimeDisplay();
  //   
  // }
  // //---------------------------------------------
  // // if (millis() - previousMillis2 >= 15000) {
  // //   previousMillis2 = millis();
  // //   OldCardID = "";
  // // }


  iniciarLeituraLED();
  // delay(2000);
  lerCartao();
  // delay(500);
  // LED("PRETO");

  // emitBeep(1, 1000, 500);
  delay(200);
  display.clearDisplay();
  // esp_sleep_enable_timer_wakeup(1000000);  // 1 segundo = 1.000.000 microssegundos
  // esp_light_sleep_start();
}








//*******Gerenciar LEDs*******

//************write datetime on the display*************





